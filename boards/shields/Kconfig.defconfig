## boards/shields/Kconfig.defconfig
```kconfig
# Copyright (c) 2020 The ZMK Contributors
# SPDX-License-Identifier: MIT

config SHIELD_CORNIE_LEFT
    def_bool $(shields_list_contains,cornie_left)

config SHIELD_CORNIE_RIGHT
    def_bool $(shields_list_contains,cornie_right)
```

## boards/shields/cornie/Kconfig.defconfig
```kconfig
if SHIELD_CORNIE_LEFT

config ZMK_KEYBOARD_NAME
    default "Cornie"

config ZMK_SPLIT_ROLE_CENTRAL
    default y

endif

if SHIELD_CORNIE_LEFT || SHIELD_CORNIE_RIGHT

config ZMK_SPLIT
    default y

endif
```

## boards/shields/cornie/Kconfig.shield
```kconfig
# Copyright (c) 2025 The ZMK Contributors
# SPDX-License-Identifier: MIT

config SHIELD_CORNIE_LEFT
    bool "Cornie Left"
    def_bool $(shields_list_contains,cornie_left)

config SHIELD_CORNIE_RIGHT
    bool "Cornie Right"
    def_bool $(shields_list_contains,cornie_right)
```
